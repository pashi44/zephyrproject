## boards/espressif/my_esp32/board.yml
```yaml
board:
  name: my_esp32
  full_name: ESP32-DevKitC
  vendor: espressif
  socs:
  - name: esp32
```

## boards/espressif/my_esp32/my_esp32_procpu_defconfig
```kconfig
# Copyright (c) 2023-2025 Espressif Systems (Shanghai) Co., Ltd.
# SPDX-License-Identifier: Apache-2.0


CONFIG_SERIAL=y
CONFIG_CONSOLE=y
CONFIG_UART_CONSOLE=y
CONFIG_STDOUT_CONSOLE=y     # optional, if you use printf/puts
CONFIG_LOG=y
CONFIG_LOG_BACKEND_UART=y
```

## dac/Kconfig
```kconfig
menu "DAC  module kconfig "

config DAC_ENABLE
	bool "enable the dac driver"
	default   n



endmenu
```

## drivers/Kconfig
```kconfig
menu "Custom driver instances"

	config LED_CUSTOM
	    bool "Enable custom GPIO LED driver"
	    default n
	    help
	      Enable support for a custom GPIO-based LED driver with multiple instances.

	if LED_CUSTOM

	config LED_CUSTOM_NUM_INSTANCES
	    int "Number of LED instances"
	    default 2
	    help
	      Sets the number of custom LED driver instances to configure.

	endif # LED_CUSTOM

endmenu
```

## drivers/drivOne/Kconfig.driveone
```kconfig
config DRIVE_ONE
    bool "Enable custom GPIO driveOne driver"
    depends on GPIO
    default y
```

## drivers/drivOne/Kconfig.drivone
```kconfig
config DRIV_ONE
    bool "Enable custom GPIO driveOne driver"
    depends on GPIO
    default y

config DRIVONE_LOG_LEVEL
    int "DrivOne driver log level"
    default 3
    depends on DRIV_ONE
```

## drivers/gpio/Kconfig
```kconfig
# Copyright (c) 2024 Nordic Semiconductor ASA
# SPDX-License-Identifier: Apache-2.0
source "zephyrproject/drivers/gpio/Kconfig.gpio_led"
```

## drivers/gpio/Kconfig.gpio_led
```kconfig
config DRIVE_ONE
    bool "Enable DriveOne GPIO driver"
    default y
    depends on GPIO
```

## gpio/Kconfig
```kconfig
menu "PWMLE Module Configuration"

config GPIO_ENABLE
    bool "Enable PWMLE module"
    default y
    help
      Enable the custom GPIO module functionality.

config GPIOPIN_PARAMETER
    int "Example parameter"
    default 2
    depends on GPIO_ENABLE
    help
      Example configuration parameter for GPIO module.

endmenu
```

## interrupt/Kconfig
```kconfig
menu "Mnaul intrerrupt module kconfig "

config MANUAL_GPIO_INTRR
	bool  "enabl;e the manual gpio interrupt driver"
	default   y

endmenu
```

## mytimers/Kconfig
```kconfig
menuconfig  MANUAL_XTAL_TIMER
    bool "the value for manual timer config"
    default n



endmenu
```

## pwmle/Kconfig
```kconfig
menu "PWMLE Module Configuration"

config PWMLE_ENABLE
    bool "Enable PWMLE module"
    default y
    help
      Enable the custom PWMLE module functionality.

config PWMLE_PARAMETER
    int "Example parameter"
    default 10
    depends on PWMLE_ENABLE
    help
      Example configuration parameter for PWMLE module.

endmenu
```
