/dts-v1/;

/* Include SoC base DTS
first to define UART/I2C/SPI/ADC nodes */

#include "/home/hadoop/zephyresp/zephyr/boards/espressif/esp32_devkitc/esp32_devkitc_appcpu.dts"


	/* Include all custom peripherals */
	#include "dtsi/my_esp32-pinctrl.dtsi"


/ {
    model = "My ESP32 ProCPU Board";
    compatible = "espressif,my_esp32_procpu";
    #address-cells =  <1>;
#size-cells=<0>;

    chosen {
        zephyr,console = &uart0;
    };

    aliases {
        my-spi = &spi2;
        my-adc0 = &adc0;
        my-adc0-channel0 = &adc0_ch0;
        my-adc0-channel1 = &adc0_ch1;
        // my-i2c-dev = &arduino_slave;
        my-uart = &uart0;
        // my-driveone0 = &driveone0;
        // my-driveone1 = &driveone1;
    };
};


	// #include "dtsi/my_esp32_driveone.dtsi"
#include "dtsi/my_esp32_uart.dtsi"
#include "dtsi/my_esp32_spi.dtsi"
// #include "dtsi/my_esp32_i2c.dtsi"
#include "dtsi/my_esp32_adc.dtsi"
#include "dtsi/my_esp32_dac.dtsi"
